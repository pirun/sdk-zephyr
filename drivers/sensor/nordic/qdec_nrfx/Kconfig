## drivers/sensor/nordic/qdec_nrfx/Kconfig
```kconfig
# Copyright (c) 2018, Nordic Semiconductor ASA
# SPDX-License-Identifier: Apache-2.0

config QDEC_NRFX
	bool "Nordic QDEC nrfx driver"
	default y
	depends on DT_HAS_NORDIC_NRF_QDEC_ENABLED
	select NRFX_QDEC0 if HAS_HW_NRF_QDEC0
	select NRFX_QDEC1 if HAS_HW_NRF_QDEC1
	select NRFX_QDEC20 if HAS_HW_NRF_QDEC20
	select NRFX_QDEC21 if HAS_HW_NRF_QDEC21
	select NRFX_QDEC130 if HAS_HW_NRF_QDEC130
	select NRFX_QDEC131 if HAS_HW_NRF_QDEC131
	select PINCTRL
	help
	  Enable support for nrfx QDEC driver for nRF MCU series.

config QDEC_NRFX_REPORTER
	int "QDEC reporter"
	default 0
	range 0 8
	help
	  Specifies the number of samples to be accumulated in the ACC register
	  before the REPORTRDY and DBLRDY events can be generated.
	  0 = 10Smpl
	  1 = 40Smpl
	  2 = 80Smpl
	  3 = 120Smpl
	  4 = 160Smpl
	  5 = 200Smpl
	  6 = 240Smpl
	  7 = 280Smpl
	  8 = 1Smpl

config QDEC_NRFX_SAMPLEPER
	int "QDEC samplerer"
	default 0
	range 0 10
	help
	  Sample period. The SAMPLE register will be updated for every new sample.
	  0 = 128us
	  1 = 256us
	  2 = 512us
	  3 = 1024us
	  4 = 2048us
	  5 = 4096us
	  6 = 8192us
	  7 = 16384us
	  8 = 32768us
	  9 = 65536us
	  10 = 131072us
```
