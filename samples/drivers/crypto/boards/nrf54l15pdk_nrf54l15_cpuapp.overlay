/*
 * Copyright (c) 2024 Nordic Semiconductor ASA
 *
 * SPDX-License-Identifier: LicenseRef-Nordic-5-Clause
 */

/ {
	soc {
		peripheral@50000000 {
			ecb00: ecb@47000 {
				compatible = "nordic,nrf-ecb";
				reg = < 0x47000 0x1000 >;
				interrupts = < 0x47 0x1 >;
				status = "okay";
			};
		};
	};
};
